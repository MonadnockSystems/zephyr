## boards/arm/nrf52_c3waironet/Kconfig.board
```kconfig
# Kconfig - nRF52 SparkFun board configuration
#
# Copyright (c) 2016 Linaro Limited.
#
# SPDX-License-Identifier: Apache-2.0


config BOARD_NRF52_C3WAIRONET
	bool "nRF52 C3Wireless Aironet EM"
	depends on SOC_NRF52832_QFAA
```

## boards/arm/nrf52_c3waironet/Kconfig.defconfig
```kconfig
# Kconfig - nRF52 Sparkfun board configuration
#
# Copyright (c) 2018 Shawn Nock <shawn@monadnock.ca>
# Copyright (c) 2016 Nordic Semiconductor ASA
#
# SPDX-License-Identifier: Apache-2.0

if BOARD_NRF52_C3WAIRONET

config BOARD
	default nrf52_c3waironet

if GPIO_NRF5

config GPIO_NRF5_P0
	default y

endif # GPIO_NRF5

if UART_NRF5

config UART_NRF5_GPIO_TX_PIN
	default 13

config UART_NRF5_GPIO_RX_PIN
	default 16

endif # UART_NRF5

endif # BOARD_NRF52_C3WAIRONET
```

## boards/arm/nrf52_c3waironet/nrf52_c3waironet_defconfig
```kconfig
CONFIG_ARM=y
CONFIG_SOC_FAMILY_NRF5=y
CONFIG_SOC_SERIES_NRF52X=y
CONFIG_SOC_NRF52832_QFAA=y
CONFIG_BOARD_NRF52_C3WAIRONET=y

# Enable MPU
CONFIG_ARM_MPU_NRF52X=y

# enable uart driver
CONFIG_SERIAL=y
CONFIG_UART_NRF5=y

# No 32k xtal
CONFIG_CLOCK_CONTROL_NRF5_K32SRC_RC=y
CONFIG_CLOCK_CONTROL_NRF5_K32SRC_250PPM=y

# bluetooth
CONFIG_BT=y
CONFIG_BT_CTLR=y
```
